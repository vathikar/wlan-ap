## feeds/wlan-ap/opensync/Config.in
```kconfig
menu "Opensync configuration"
	depends on PACKAGE_opensync

config OPENSYNC_TARGET
	string "OpenSync vendor target"
	default TIP
	help
		Valid targets are:
		TIP - Using vendor/tip and platform/openwrt (TIP default)
		GENERIC_CFG80211 - Using vendor/plume-openwrt and platform/cfg80211

endmenu
```

## feeds/wlan-ap/opensync/src/platform/openwrt/kconfig/Kconfig.platform
```kconfig
menuconfig PLATFORM_IS_OPENWRT
    bool "OpenWrt"
    help
        Support for OpenWrt UCI

if PLATFORM_IS_OPENWRT

comment "OSN API"
rsource "../src/lib/osn/kconfig/Kconfig.osn"

endif
```

## feeds/wlan-ap/opensync/src/platform/openwrt/src/lib/osn/kconfig/Kconfig.osn
```kconfig
menuconfig OSN_UCI_ENABLED
    bool "OpenWrt UCI Implementation"
    help
        Provide an OpenWrt UCI implementation of the OSN API. This includes:
            - Linux L2 interface support (via ioctl())
            - IPv4 support (via iproute2)
            - IPv6 support (via iproute2)
            - DHCPv4 server support (via dnsmasq)
            - DHCPv4 client support (via udhcpc)
            - DHCPv6 server support (via dnsmasq)
            - DHCPv6 client support (via odhcp6c)
            - Router Advertisement support (via dnsmasq)
            - UPnP support (via miniupnpd)
            - PPPoE support (via pppd)
            - VLAN support (via iproute2)
            - QoS support (via tc)

if OSN_UCI_ENABLED

    config OSN_UCI_IP
        bool "OpenWrt UCI IPv4"
        help
            OpenSync IPv4 implementation (OpenWrt UCI)

            This option implements the uci_ip API and enables the
            "UCI_IPv4" backend (osn_ip).

endif
```

## feeds/wlan-ap/opensync/src/platform/openwrt/src/lib/osn/kconfig/Kconfig.osn.ipv4_backend
```kconfig
config OSN_BACKEND_IPV4_UCI
    bool "UCI"
    select OSN_UCI_ENABLED
    select OSN_UCI_IP
    help
        Use the UCI IPv4 backend provided by OpenSync/TIP
```

## feeds/wlan-ap/opensync/src/platform/openwrt/src/netifd/kconfig/Kconfig.managers
```kconfig
menuconfig MANAGER_NM_NETIFD
    bool "Network Manager (NM NETIFD)"
    depends on !MANAGER_NM
    default y
    help
        Enable Network Manager (NM NETIFD)

    config MANAGER_NM_NETIFD_CFG
        depends on MANAGER_NM_NETIFD
        string "NM NETIFD Startup configuration"
        default "nm;true;needs_plan_b=true"
        help
            Network Manager (NM NETIFD) startup configuration
```
